## board/kontron/pitx_imx8m/Kconfig
```kconfig
if TARGET_KONTRON_PITX_IMX8M

config SYS_BOARD
	default "pitx_imx8m"

config SYS_VENDOR
	default "kontron"

config SYS_CONFIG_NAME
	default "kontron_pitx_imx8m"

endif
```
